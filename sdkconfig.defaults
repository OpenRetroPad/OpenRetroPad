## sdkconfig.defaults
```kconfig
# Override some defaults so BT stack is enabled
# and WiFi disabled by default in this example
CONFIG_BT_ENABLED=y
CONFIG_ESP32_ENABLE_STACK_BT=y

CONFIG_BTDM_CTRL_MODE_BLE_ONLY=y

CONFIG_BTDM_CTRL_MODE_BR_EDR_ONLY=n
CONFIG_BTDM_CTRL_MODE_BTDM=n

CONFIG_WIFI_ENABLED=n
CONFIG_ESP32_ENABLE_STACK_WIFI=n
CONFIG_ESP32_WIFI_SW_COEXIST_ENABLE=n
```
